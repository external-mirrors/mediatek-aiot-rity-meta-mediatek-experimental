// SPDX-License-Identifier: GPL-2.0-only
/*
 * Copyright (c) 2026 MediaTek Inc.
 *
 * Camera GPIO standardization
 */

#include "camera-single-csi0-single-csi1.dts"

/ {
	fragment@30 {
		target = <&i2c7>;
		__overlay__ {
			camera-main@1a {
				status = "disabled";
			};
		};
	};
};

/* CAMERA EEPROM end */
